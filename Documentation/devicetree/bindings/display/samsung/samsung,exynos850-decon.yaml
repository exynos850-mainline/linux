## Documentation/devicetree/bindings/display/samsung/samsung,exynos850-decon.yaml
```yaml
# SPDX-License-Identifier: (GPL-2.0-only OR BSD-2-Clause)
%YAML 1.2
---
$id: http://devicetree.org/schemas/display/samsung/samsung,exynos850-decon.yaml#
$schema: http://devicetree.org/meta-schemas/core.yaml#

title: Samsung Exynos850 DECON display controller

maintainers:
  - Thomas Turner <tturner@lineageos.org>

description: |
  The DECON blends up to four windows and sends the result to the MIPI DSI
  master. The windows are fetched from memory by the DPU_DMA block, whose
  channels are driven together with the DECON.

properties:
  compatible:
    const: samsung,exynos850-decon

  reg:
    items:
      - description: DECON registers
      - description: DPU_DMA registers, starting with the common block

  reg-names:
    items:
      - const: decon
      - const: dma

  interrupts:
    items:
      - description: frame start
      - description: frame done
      - description: errors (timeout, resource conflict)

  interrupt-names:
    items:
      - const: frame-start
      - const: frame-done
      - const: extra

  clocks:
    items:
      - description: DECON bus clock
      - description: DPU_DMA bus clock
      - description: DPP bus clock
      - description: PPMU bus clock
      - description: PPMU register clock
      - description: DPU SysMMU clock

  clock-names:
    items:
      - const: aclk
      - const: dma
      - const: dpp
      - const: ppmu-aclk
      - const: ppmu-pclk
      - const: smmu

  iommus:
    maxItems: 1

  memory-region:
    maxItems: 1
    description:
      Framebuffer left running by the bootloader. Its reserved-memory node
      should carry an identity iommu-addresses entry so that scanout keeps
      working once the IOMMU is enabled.

  power-domains:
    maxItems: 1

required:
  - compatible
  - reg
  - reg-names
  - interrupts
  - interrupt-names
  - clocks
  - clock-names

additionalProperties: false

examples:
  - |
    #include <dt-bindings/clock/exynos850.h>
    #include <dt-bindings/interrupt-controller/arm-gic.h>

    display-controller@13060000 {
        compatible = "samsung,exynos850-decon";
        reg = <0x13060000 0x10000>, <0x130b0000 0x5000>;
        reg-names = "decon", "dma";
        interrupts = <GIC_SPI 114 IRQ_TYPE_LEVEL_HIGH>,
                     <GIC_SPI 113 IRQ_TYPE_LEVEL_HIGH>,
                     <GIC_SPI 112 IRQ_TYPE_LEVEL_HIGH>;
        interrupt-names = "frame-start", "frame-done", "extra";
        clocks = <&cmu_dpu CLK_GOUT_DPU_DECON0_ACLK>,
                 <&cmu_dpu CLK_GOUT_DPU_DMA_ACLK>,
                 <&cmu_dpu CLK_GOUT_DPU_DPP_ACLK>,
                 <&cmu_dpu CLK_GOUT_DPU_PPMU_ACLK>,
                 <&cmu_dpu CLK_GOUT_DPU_PPMU_PCLK>,
                 <&cmu_dpu CLK_GOUT_DPU_SMMU_CLK>;
        clock-names = "aclk", "dma", "dpp", "ppmu-aclk", "ppmu-pclk", "smmu";
    };
```

## Documentation/devicetree/bindings/display/samsung/samsung,exynos850-mipi-dsi.yaml
```yaml
# SPDX-License-Identifier: (GPL-2.0-only OR BSD-2-Clause)
%YAML 1.2
---
$id: http://devicetree.org/schemas/display/samsung/samsung,exynos850-mipi-dsi.yaml#
$schema: http://devicetree.org/meta-schemas/core.yaml#

title: Samsung Exynos850 MIPI DSI master

maintainers:
  - Thomas Turner <tturner@lineageos.org>

description: |
  MIPI DSI master of the Exynos850 display subsystem, with its integrated
  D-PHY. The D-PHY reset is controlled through the DPU system registers and
  its isolation through the PMU.

allOf:
  - $ref: /schemas/display/dsi-controller.yaml#

properties:
  compatible:
    const: samsung,exynos850-mipi-dsi

  reg:
    items:
      - description: DSIM registers
      - description: D-PHY registers

  reg-names:
    items:
      - const: dsim
      - const: phy

  interrupts:
    maxItems: 1

  clocks:
    items:
      - description: bus clock
      - description: D-PHY PLL reference clock

  clock-names:
    items:
      - const: bus
      - const: pll

  samsung,disp-sysreg:
    $ref: /schemas/types.yaml#/definitions/phandle
    description: DPU system registers, used for the D-PHY reset

  samsung,pmu-syscon:
    $ref: /schemas/types.yaml#/definitions/phandle
    description: PMU, used for the D-PHY isolation

  samsung,burst-clock-frequency:
    description: DSI lane rate in Hz

  samsung,esc-clock-frequency:
    description: DSI escape clock frequency in Hz, between 7 and 20 MHz
    minimum: 7000000
    maximum: 20000000

  power-domains:
    maxItems: 1

required:
  - compatible
  - reg
  - reg-names
  - interrupts
  - clocks
  - clock-names
  - samsung,disp-sysreg
  - samsung,pmu-syscon
  - samsung,burst-clock-frequency
  - samsung,esc-clock-frequency

unevaluatedProperties: false

examples:
  - |
    #include <dt-bindings/clock/exynos850.h>
    #include <dt-bindings/interrupt-controller/arm-gic.h>

    dsi@13070000 {
        compatible = "samsung,exynos850-mipi-dsi";
        reg = <0x13070000 0x200>, <0x13080000 0x3000>;
        reg-names = "dsim", "phy";
        interrupts = <GIC_SPI 121 IRQ_TYPE_LEVEL_HIGH>;
        clocks = <&cmu_dpu CLK_DOUT_DPU_BUSP>, <&oscclk>;
        clock-names = "bus", "pll";
        samsung,disp-sysreg = <&sysreg_dpu>;
        samsung,pmu-syscon = <&pmu_system_controller>;
        samsung,burst-clock-frequency = <830000000>;
        samsung,esc-clock-frequency = <20000000>;
        #address-cells = <1>;
        #size-cells = <0>;
    };
```

## Documentation/devicetree/bindings/net/wireless/samsung,exynos850-wlbt.yaml
```yaml
# SPDX-License-Identifier: (GPL-2.0-only OR BSD-2-Clause)
%YAML 1.2
---
$id: http://devicetree.org/schemas/net/wireless/samsung,exynos850-wlbt.yaml#
$schema: http://devicetree.org/meta-schemas/core.yaml#

title: Samsung Exynos850 WLBT (Maxwell) Wi-Fi/Bluetooth subsystem

maintainers:
  - Thomas Turner <tturner@lineageos.org>

description:
  The WLBT subsystem integrated in the Exynos850 SoC contains the processors
  running the Wi-Fi and Bluetooth firmware, which the host loads into a
  reserved area of the DRAM. The host powers the subsystem up through the
  PMU, configures the bus windows through which the subsystem sees the shared
  memory and the mailboxes, and then communicates with the firmware through
  the AP2WLBT mailbox and the shared memory.

properties:
  compatible:
    const: samsung,exynos850-wlbt

  reg:
    items:
      - description: AP2WLBT mailbox
      - description: WLBT data bus address window (DBUS BAAW)
      - description: WLBT peripheral bus address window (PBUS BAAW)
      - description: WLBT remap configuration
      - description: WLBT boot configuration
      - description: APM PMIC interface (VGPIO monitor)

  reg-names:
    items:
      - const: mbox
      - const: dbus-baaw
      - const: pbus-baaw
      - const: remap
      - const: boot-cfg
      - const: apm-pmic

  interrupts:
    items:
      - description: AP2WLBT mailbox interrupt
      - description: WLBT watchdog / reset request
      - description: WLBT configuration request (boot)

  interrupt-names:
    items:
      - const: mbox
      - const: wdog
      - const: cfg-req

  memory-region:
    maxItems: 1
    description:
      Shared memory area holding the firmware and the host interface
      structures, at least 12 MiB, 4 KiB aligned.

  samsung,pmu-syscon:
    $ref: /schemas/types.yaml#/definitions/phandle
    description: Phandle to the PMU system controller.

required:
  - compatible
  - reg
  - reg-names
  - interrupts
  - interrupt-names
  - memory-region
  - samsung,pmu-syscon

additionalProperties: false

examples:
  - |
    #include <dt-bindings/interrupt-controller/arm-gic.h>

    wifi@119c0000 {
        compatible = "samsung,exynos850-wlbt";
        reg = <0x119c0000 0x180>,
              <0x14c20000 0x300>,
              <0x14c30000 0x300>,
              <0x14c50000 0x500>,
              <0x14c60000 0x1200>,
              <0x11a50000 0x1800>;
        reg-names = "mbox", "dbus-baaw", "pbus-baaw", "remap", "boot-cfg",
                    "apm-pmic";
        interrupts = <GIC_SPI 54 IRQ_TYPE_LEVEL_HIGH>,
                     <GIC_SPI 231 IRQ_TYPE_LEVEL_HIGH>,
                     <GIC_SPI 230 IRQ_TYPE_LEVEL_HIGH>;
        interrupt-names = "mbox", "wdog", "cfg-req";
        memory-region = <&wlbt_mem>;
        samsung,pmu-syscon = <&pmu_system_controller>;
    };
```

## Documentation/devicetree/bindings/net/wwan/samsung,s5000ap-modem.yaml
```yaml
# SPDX-License-Identifier: (GPL-2.0-only OR BSD-2-Clause)
%YAML 1.2
---
$id: http://devicetree.org/schemas/net/wwan/samsung,s5000ap-modem.yaml#
$schema: http://devicetree.org/meta-schemas/core.yaml#

title: Samsung Exynos S5000AP cellular modem

maintainers:
  - schoosh212 <superaviation001@gmail.com>

description: |
  On-die Samsung Shannon cellular processor found on Exynos850 phones. The
  AP communicates with it through a mailbox, a reserved mem carveout and a
  secure-monitor call. The driver loads the CP firmware (modem.bin) itself,
  powers the CP via PMU register sequences and exposes the SIPC5 channels as
  WWAN ports and raw-IP netdevs.

properties:
  compatible:
    const: samsung,s5000ap-modem

  reg:
    minItems: 1
    items:
      - description: CP mailbox (interrupt and shared status registers)
      - description: AP2CP_CFG register that lets the CP CPU start

  reg-names:
    minItems: 1
    items:
      - const: mailbox
      - const: ap2cp-cfg

  interrupts:
    minItems: 1
    items:
      - description: CP mailbox interrupt
      - description: CP watchdog / reset request

  interrupt-names:
    minItems: 1
    items:
      - const: mailbox
      - const: cp-reset-req

  memory-region:
    maxItems: 1
    description: >
      Reserved (no-map) carveout shared with the CP, at least 0x8800000 bytes
      laid out as CP 0x6900000, VSS 0x700000, IPC 0x800000, BTL 0x1000000.

  firmware-name:
    $ref: /schemas/types.yaml#/definitions/string
    description: Firmware path, defaults to samsung/s5000ap/modem.bin.

  pinctrl-0: true
  pinctrl-names: true

  samsung,hw-revision:
    $ref: /schemas/types.yaml#/definitions/uint32
    maximum: 255
    description: Board revision published to the CP (androidboot.revision).

  samsung,cp-status:
    $ref: /schemas/types.yaml#/definitions/uint32-array
    description: >
      How to read "CP domain powered".  The CP is considered powered when
      (value & mask) == 1.
    items:
      - description: >
          Kind, 0 for a physical MMIO address, 1 for an SMC read of a secure
          CP_CTRL register
        enum: [0, 1]
      - description: >
          MMIO physical address (kind 0) or CP_CTRL selector, 0 = CP_CTRL_S and
          1 = CP_CTRL_NS (kind 1)
      - description: Mask applied to the register value
    minItems: 3
    maxItems: 3

  samsung,cp-init-seq:
    $ref: /schemas/types.yaml#/definitions/uint32-matrix
    description: >
      PMU steps that power the CP (downstream cal_cp_init).  Tuples of
      <op address mask value>; op 0 update, 1 write, 2 wait, 3 delay (us), 4 SMC update, 5 SMC write (address = 0 CP_CTRL_S or 1 CP_CTRL_NS).
    items:
      minItems: 4
      maxItems: 4

  samsung,cp-reset-assert-seq:
    $ref: /schemas/types.yaml#/definitions/uint32-matrix
    description: Steps that hold the CP in reset (cal_cp_reset_assert).
    items:
      minItems: 4
      maxItems: 4

  samsung,cp-reset-release-seq:
    $ref: /schemas/types.yaml#/definitions/uint32-matrix
    description: Steps that release the CP reset (cal_cp_reset_release).
    items:
      minItems: 4
      maxItems: 4

  samsung,cp-dump-enable-seq:
    $ref: /schemas/types.yaml#/definitions/uint32-matrix
    items:
      minItems: 4
      maxItems: 4

  samsung,cp-dump-disable-seq:
    $ref: /schemas/types.yaml#/definitions/uint32-matrix
    items:
      minItems: 4
      maxItems: 4

required:
  - compatible
  - reg
  - reg-names
  - interrupts
  - interrupt-names
  - memory-region
  - samsung,cp-status
  - samsung,cp-init-seq
  - samsung,cp-reset-assert-seq
  - samsung,cp-reset-release-seq

additionalProperties: false

examples:
  - |
    #include <dt-bindings/interrupt-controller/arm-gic.h>

    modem@11920000 {
        compatible = "samsung,exynos850-s5000ap-modem";
        reg = <0x11920000 0x180>, <0x14020000 0x4>;
        reg-names = "mailbox", "ap2cp-cfg";
        interrupts = <GIC_SPI 51 IRQ_TYPE_LEVEL_HIGH>,
                     <GIC_SPI 190 IRQ_TYPE_LEVEL_HIGH>;
        interrupt-names = "mailbox", "cp-reset-req";
        memory-region = <&cp_rmem>;
        samsung,firmware-partition = "radio";
        samsung,hw-revision = <6>;
        samsung,cp-status = <0 0x11863004 0x1>;
        samsung,cp-init-seq = <3 0 0 1>;
        samsung,cp-reset-assert-seq = <3 0 0 1>;
        samsung,cp-reset-release-seq = <3 0 0 1>;
    };
```
