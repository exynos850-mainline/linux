// SPDX-License-Identifier: GPL-2.0
/*
 * Samsung Galaxy A13 (A135F) 3GB RAM variant board device tree source
 * This just configures the memory, and includes the common device source for everything else.
 * Copyright (c), 2026, schoosh212 <superaviation001@gmail.com>
 */

/dts-v1/;

#include "exynos850-a135f-common.dtsi"
#include <dt-bindings/gpio/gpio.h>
#include <dt-bindings/input/input.h>
#include <dt-bindings/leds/common.h>

/ {
        model = "Samsung Galaxy A13 (A135F) (3GB)";
        compatible = "samsung,a135f", "samsung,a135f-3gb", "samsung,exynos850";
        #address-cells = <2>;
        #size-cells = <2>;

	memory@80000000 {
		device_type = "memory";
		reg = <0x0 0x80000000 0x0 0x3c900000>,
		      /* Memory hole */
		      <0x0 0xc0000000 0x0 0x20000000>,
		      /* Memory hole */
		      <0x0 0xe0d00000 0x0 0x1f300000>,
		      /* Memory hole - last block */
		      <0x8 0x80000000 0x0 0x40000000>;
	};
};
